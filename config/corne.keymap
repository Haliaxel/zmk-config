/ {
    keymap {
        compatible = "zmk,keymap";

        layers {
            default {
                bindings = <
                    &kp Q &kp W &kp E &kp R &kp T
                    &kp A &kp S &kp D &kp F &kp G
                    &kp Z &kp X &kp C &kp V &kp B
                    &trans &trans &trans &kp SPACE &kp ENTER
                >;
            };
        };
    };
};
